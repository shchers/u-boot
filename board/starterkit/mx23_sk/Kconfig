## board/starterkit/mx23_sk/Kconfig
```kconfig
if TARGET_MX23_SK

config SYS_BOARD
	default "mx23_sk"

config SYS_VENDOR
	default "starterkit"

config SYS_SOC
	default "mxs"

config SYS_CONFIG_NAME
	default "mx23_sk"

endif
```
